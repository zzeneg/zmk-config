## config/boards/shields/ledview_adapter/Kconfig.shield
```kconfig
config SHIELD_LEDVIEW_ADAPTER
    def_bool $(shields_list_contains,ledview_adapter)
```

## config/boards/shields/nice_view_custom/Kconfig.defconfig
```kconfig
if SHIELD_NICE_VIEW_CUSTOM

if !ZMK_SPLIT || ZMK_SPLIT_ROLE_CENTRAL

config NICE_VIEW_WIDGET_STATUS
    select LV_FONT_MONTSERRAT_22
    select LV_FONT_MONTSERRAT_18

endif # !ZMK_SPLIT || ZMK_SPLIT_ROLE_CENTRAL

endif # SHIELD_NICE_VIEW_CUSTOM
```

## config/west.yml
```yaml
manifest:
  remotes:
    - name: zmkfirmware
      url-base: https://github.com/zmkfirmware
    - name: zzeneg
      url-base: https://github.com/zzeneg
    - name: caksoylar
      url-base: https://github.com/caksoylar
  projects:
    - name: zmk
      remote: zmkfirmware
      revision: main
      import: app/west.yml
    - name: zmk-raw-hid
      remote: zzeneg
      revision: main
    - name: zmk-nice-view-hid
      remote: zzeneg
      revision: main
    - name: zmk-rgbled-widget
      remote: caksoylar
      revision: main
  self:
    path: config
```
