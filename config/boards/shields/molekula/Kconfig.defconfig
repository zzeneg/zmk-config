## config/boards/shields/molekula/Kconfig.defconfig
```kconfig
# Copyright (c) 2020 The ZMK Contributors
# SPDX-License-Identifier: MIT

if SHIELD_MOLEKULA

config ZMK_KEYBOARD_NAME
    default "molekula"

endif
```

## config/boards/shields/molekula/Kconfig.shield
```kconfig
# Copyright (c) 2020 The ZMK Contributors
# SPDX-License-Identifier: MIT

config SHIELD_MOLEKULA
   def_bool $(shields_list_contains,molekula)
```
